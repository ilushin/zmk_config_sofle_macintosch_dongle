## config/boards/shields/left_bbtrackpad_dongle/Kconfig.shield
```kconfig
# Copyright (c) 2022 The ZMK Contributors
# SPDX-License-Identifier: MIT

config SHIELD_LEFT_BBTRACKPAD_DONGLE
    def_bool $(shields_list_contains,left_bbtrackpad_dongle)

menu "A320 Trackpad Setting"

config A320_TRACKPAD_SCROLL_INTERVAL
    int "Trackpad scroll interval in milliseconds"
    default 50
    range 0 200

config A320_LOG_LEVEL
    int "A320 log level (0=off, 1=error, 2=warning, 3=info, 4=debug)"
    default 2
    range 0 4

config A320
    bool "A320 Driver"
    depends on I2C && GPIO

config INPUT_A320_INIT_PRIORITY
    int "A320 Initialization Priority"
    default 90

endmenu

menu "A320 Advanced Settings"

config A320_EXPONENTIAL
    bool "Enable A320 exponential acceleration"
    default y

config A320_TOGGLE_KEY_POSITION
    int "Key position to toggle mouse/scroll mode"
    default 62

config A320_START_IN_SCROLL_MODE
    bool "Start in scroll mode by default"
    default y

config A320_SCROLL_X_DIR
    int "Scroll X direction multiplier"
    default 1
    range -1 1

config A320_SCROLL_Y_DIR
    int "Scroll Y direction multiplier"
    default 1
    range -1 1

config A320_SCROLL_DEADZONE
    int "Scroll deadzone"
    default 1
    range 0 32

config A320_SCROLL_INPUT_MAX
    int "Scroll input maximum"
    default 64
    range 1 127

config A320_SCROLL_DIVISOR_SLOW
    int "Slow scroll divisor"
    default 60
    range 1 255

config A320_SCROLL_DIVISOR_FAST
    int "Fast scroll divisor"
    default 8
    range 1 255

config A320_DOMINANT_NUMERATOR
    int "Dominant axis numerator"
    default 3
    range 1 16

config A320_DOMINANT_DENOMINATOR
    int "Dominant axis denominator"
    default 2
    range 1 16

config A320_MOUSE_BASE_SPEED_PERCENT
    int "Mouse base speed percentage"
    default 150
    range 10 400

config A320_MOUSE_SENS_BASE_PERCENT
    int "Mouse sensitivity base percentage"
    default 40
    range 0 400

config A320_MOUSE_SENS_STEP_PERCENT
    int "Mouse sensitivity step per LED brightness"
    default 1
    range 0 20

config CUSTOM_LED_BRT_UP_POS
    int "Custom LED brightness UP key position"
    default 49

config CUSTOM_LED_BRT_DOWN_POS
    int "Custom LED brightness DOWN key position"
    default 50

config CUSTOM_LED_BRT_DEFAULT
    int "Custom LED default brightness"
    default 128
    range 10 255

config CUSTOM_LED_BRT_STEP
    int "Custom LED brightness adjustment step"
    default 25
    range 1 100

endmenu
```

## config/boards/shields/right_trackpoint_dongle/Kconfig.shield
```kconfig
# Copyright (c) 2022 The ZMK Contributors
# SPDX-License-Identifier: MIT

config SHIELD_RIGHT_TRACKPOINT_DONGLE
    def_bool $(shields_list_contains,right_trackpoint_dongle)

menu "TrackPoint Advanced Settings"

config TRACKPOINT_LOG_LEVEL
    int "TrackPoint log level (0=off, 1=error, 2=warning, 3=info, 4=debug)"
    default 2
    range 0 4

config TRACKPOINT_EXPONENTIAL
    bool "Enable TrackPoint exponential acceleration"
    default y

config TRACKPOINT_SCROLL_X_DIR
    int "Scroll X direction multiplier"
    default 1
    range -1 1

config TRACKPOINT_SCROLL_Y_DIR
    int "Scroll Y direction multiplier"
    default 1
    range -1 1

config TRACKPOINT_SCROLL_DEADZONE
    int "Scroll deadzone"
    default 2
    range 0 32

config TRACKPOINT_SCROLL_INPUT_MAX
    int "Scroll input maximum"
    default 128
    range 1 255

config TRACKPOINT_SCROLL_DIVISOR_SLOW
    int "Slow scroll divisor"
    default 60
    range 1 255

config TRACKPOINT_SCROLL_DIVISOR_FAST
    int "Fast scroll divisor"
    default 8
    range 1 255

config TRACKPOINT_DOMINANT_NUMERATOR
    int "Dominant axis numerator"
    default 3
    range 1 16

config TRACKPOINT_DOMINANT_DENOMINATOR
    int "Dominant axis denominator"
    default 2
    range 1 16

config TRACKPOINT_MOUSE_BASE_SPEED_PERCENT
    int "Mouse base speed percentage"
    default 50
    range 10 400

config TRACKPOINT_MOUSE_SENS_BASE_PERCENT
    int "Mouse sensitivity base percentage"
    default 30
    range 0 400

config TRACKPOINT_MOUSE_SENS_STEP_PERCENT
    int "Mouse sensitivity step per LED brightness"
    default 1
    range 0 20

endmenu
```
